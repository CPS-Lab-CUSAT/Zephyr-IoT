&uart2_default {
	status = "okay";

	w1: w1 {
		compatible = "zephyr,w1-serial";
		status = "okay";

		ds18b20 {
			compatible = "maxim,ds18b20";
			family-code = <0x28>;
			resolution = <12>;
			status = "okay";
		};
	};
};

&uart2_default { 
  group1 {
    bias-pull-up;
    drive-open-drain;
  };
};
